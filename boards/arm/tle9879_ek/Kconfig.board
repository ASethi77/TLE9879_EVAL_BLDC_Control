## boards/arm/tle9879_ek/Kconfig.board
```kconfig
# Copyright (c) 2022 Aakash Sethi
# SPDX-License-Identifier: GPL-3.0-only

config BOARD_TLE9879_EK
	bool "Infineon TLE9879 Evaluation Kit"
	depends on SOC_NRF52840_QIAA
```

## boards/arm/tle9879_ek/Kconfig.defconfig
```kconfig
# Copyright (c) 2022 Aakash Sethi
# SPDX-License-Identifier: GPL-3.0-only

if BOARD_TLE9879_EK

config BOARD
	default "tle9879_ek"

# See https://docs.zephyrproject.org/latest/guides/porting/board_porting.html#create-your-board-directory

endif # BOARD_TLE9879_EK
```

## west.yml
```yaml
# Copyright (c) Aakash Sethi
# SPDX-License-Identifier: Apache-2.0

manifest:
  self:
    path: infineon_eval_foc

  remotes:
    - name: zephyrproject-rtos
      url-base: https://github.com/zephyrproject-rtos
    - name: zephyrproject-rtos-fork
      url-base: https://github.com/ASethi77

  projects:
    - name: zephyr
      remote: zephyrproject-rtos-fork
      revision: infineon_tle9879_ek_soc
      import: true
```
